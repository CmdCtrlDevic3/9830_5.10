## drivers/media/platform/exynos/camera/ischain/Kconfig
```kconfig
config PABLO_V7_0_0
	bool "Use PABLO v7.0.0"
	depends on SOC_EXYNOS9820
	select EXYNOS_DEVICE_MIPI_CSIS_VER4
	select CSIS_V5_2
	select CAMERA_CIS_SELECT
	select CAMERA_ACT_SELECT
	select CAMERA_FLASH_SELECT
	select CAMERA_PDP
	select CAMERA_MC_SCALER_VER2_USE
	select CAMERA_TDNR_VER2_USE
	select MC_SCALER_V5_0
	select VRA_V2_0
	help
	  PABLO ISP version 7.0.0

config PABLO_V8_0_0
	bool "Use PABLO v8.0.0"
	depends on SOC_EXYNOS9830_EVT0
	select EXYNOS_DEVICE_MIPI_CSIS_VER4
	select CSIS_V5_3
	select CAMERA_CIS_SELECT
	select CAMERA_ACT_SELECT
	select CAMERA_FLASH_SELECT
	select CAMERA_PDP
	select MC_SCALER_V8_0
	select PDP_V1_0_0
	help
	  PABLO ISP version 8.0.0

config PABLO_V8_1_0
	bool "Use PABLO v8.1.0"
	depends on SOC_EXYNOS9830
	select EXYNOS_DEVICE_MIPI_CSIS_VER4
	select CSIS_V5_3
	select CAMERA_CIS_SELECT
	select CAMERA_ACT_SELECT
	select CAMERA_FLASH_SELECT
	select CAMERA_PDP
	select MC_SCALER_V8_1
	select PDP_V1_0_0
	help
	  PABLO ISP version 8.1.0

config PABLO_V8_10_0
	bool "Use PABLO v8.10.0"
	depends on SOC_EXYNOS9630
	select EXYNOS_DEVICE_MIPI_CSIS_VER4
	select CSIS_V5_3
	select CAMERA_CIS_SELECT
	select CAMERA_ACT_SELECT
	select CAMERA_FLASH_SELECT
	select CAMERA_PDP
	select MC_SCALER_V8_10
	select PDP_V1_0_0
	help
	  PABLO ISP version 8.0.0

config PABLO_V8_20_0
	bool "Use PABLO v8.20.0"
	depends on SOC_S5E3830
	default y
	select EXYNOS_DEVICE_MIPI_CSIS_VER4
	select CSIS_V1_2
	select CAMERA_CIS_SELECT
	select CAMERA_ACT_SELECT
	select CAMERA_FLASH_SELECT
	select MC_SCALER_V8_20
	help
	  PABLO ISP version 8.20.0
```
